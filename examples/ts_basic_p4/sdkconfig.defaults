## examples/ts_basic_p4/sdkconfig.defaults
```kconfig
# MicroLink v2 - ESP32-P4 Ethernet skeleton sdkconfig defaults

# Target
CONFIG_IDF_TARGET="esp32p4"

# PSRAM (required for large control-plane buffers)
CONFIG_SPIRAM=y
CONFIG_SPIRAM_SPEED_200M=y

# lwIP (WireGuard needs raw sockets + larger buffers)
CONFIG_LWIP_MAX_SOCKETS=16
CONFIG_LWIP_SO_RCVBUF=y
CONFIG_LWIP_TCPIP_RECVMBOX_SIZE=64
CONFIG_LWIP_TCP_SND_BUF_DEFAULT=32768
CONFIG_LWIP_TCP_WND_DEFAULT=32768

# mbedTLS (Noise protocol needs ChaCha20-Poly1305)
CONFIG_MBEDTLS_CHACHA20_C=y
CONFIG_MBEDTLS_POLY1305_C=y
CONFIG_MBEDTLS_CHACHAPOLY_C=y
CONFIG_MBEDTLS_HKDF_C=y
CONFIG_MBEDTLS_SSL_PROTO_TLS1_2=y

# FreeRTOS
CONFIG_FREERTOS_HZ=1000
CONFIG_FREERTOS_TIMER_TASK_STACK_DEPTH=4096

# CPU frequency / watchdog
CONFIG_ESP_DEFAULT_CPU_FREQ_MHZ_360=y
CONFIG_ESP_TASK_WDT_TIMEOUT_S=30

# Partition table
CONFIG_PARTITION_TABLE_SINGLE_APP_LARGE=y

# Log level
CONFIG_LOG_DEFAULT_LEVEL_INFO=y

# HTTP Config Server (runtime auth/peer config via web UI)
CONFIG_ML_ENABLE_CONFIG_HTTPD=y
CONFIG_ML_CONFIG_MAX_ALLOWED_PEERS=512

# Priority peer (guaranteed WG slot even when peer table is full)
CONFIG_ML_PRIORITY_PEER_IP=""
```
